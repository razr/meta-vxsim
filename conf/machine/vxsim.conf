## conf/machine/vxsim.conf
```bitbake
#@TYPE: Machine
#@NAME: VxWorks Simulator
#@DESCRIPTION: Machine configuration for the VxWorks Simulator

DEFAULTTUNE ?= "arm1176jzfshf"

require conf/machine/include/meta-intel.inc

SERIAL_CONSOLE = "115200 ttyAMA0"
```
